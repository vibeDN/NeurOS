## Config.in
```kconfig
menu "NeurOS packages"

source "$BR2_EXTERNAL_NEUROS_PATH/package/neuros-comp/Config.in"
source "$BR2_EXTERNAL_NEUROS_PATH/package/neuros-agentd/Config.in"
source "$BR2_EXTERNAL_NEUROS_PATH/package/fish/Config.in"
source "$BR2_EXTERNAL_NEUROS_PATH/package/fastfetch/Config.in"
source "$BR2_EXTERNAL_NEUROS_PATH/package/claude-code/Config.in"
source "$BR2_EXTERNAL_NEUROS_PATH/package/piper/Config.in"
source "$BR2_EXTERNAL_NEUROS_PATH/package/piper-voices/Config.in"
source "$BR2_EXTERNAL_NEUROS_PATH/package/whisper-cpp/Config.in"
source "$BR2_EXTERNAL_NEUROS_PATH/package/whisper-model/Config.in"

endmenu
```

## package/claude-code/Config.in
```kconfig
config BR2_PACKAGE_CLAUDE_CODE
	bool "claude-code (agent CLI)"
	depends on BR2_x86_64
	depends on BR2_TOOLCHAIN_USES_GLIBC
	select BR2_PACKAGE_CA_CERTIFICATES
	help
	  Anthropic's Claude Code CLI - the v1 NeurOS agent. Ships the
	  self-contained native binary (no Node.js). Auth (OAuth / API key /
	  enterprise) is provisioned separately into /root/.claude.

	  The binary is taken from the host's installed Claude Code
	  (~/.local/share/claude/versions/$VERSION); override with
	  CLAUDE_CODE_BIN=/path on the make command line.

comment "claude-code needs an x86_64 glibc toolchain"
	depends on !BR2_x86_64 || !BR2_TOOLCHAIN_USES_GLIBC
```

## package/fastfetch/Config.in
```kconfig
config BR2_PACKAGE_FASTFETCH
	bool "fastfetch"
	depends on BR2_TOOLCHAIN_HAS_THREADS
	depends on BR2_USE_MMU
	help
	  A maintained, feature-rich and performance oriented system
	  information tool. NeurOS uses it for the shell greeting with a
	  per-agent logo.

	  Built minimal here (no vulkan/wayland/x/imagemagick/lua/...).

	  https://github.com/fastfetch-cli/fastfetch

comment "fastfetch needs a toolchain w/ threads"
	depends on !BR2_TOOLCHAIN_HAS_THREADS
```

## package/fish/Config.in
```kconfig
config BR2_PACKAGE_FISH
	bool "fish (interactive shell)"
	depends on BR2_INSTALL_LIBSTDCPP
	depends on BR2_TOOLCHAIN_HAS_THREADS
	depends on BR2_USE_WCHAR
	depends on !BR2_STATIC_LIBS
	select BR2_PACKAGE_NCURSES
	select BR2_PACKAGE_NCURSES_WCHAR
	select BR2_PACKAGE_PCRE2
	select BR2_PACKAGE_PCRE2_32 # fish links libpcre2-32 (wchar_t width)
	help
	  fish - the friendly interactive shell. Autosuggestions, syntax
	  highlighting, sane scripting. Used as the interactive login shell
	  on NeurOS (the agent CLI still runs under /bin/sh).

	  Last C++/CMake release line (4.x is Rust); tracks 3.7.x.

	  https://fishshell.com

comment "fish needs a toolchain w/ C++, threads, wchar, dynamic libs"
	depends on !BR2_INSTALL_LIBSTDCPP || !BR2_TOOLCHAIN_HAS_THREADS \
		|| !BR2_USE_WCHAR || BR2_STATIC_LIBS
```

## package/neuros-agentd/Config.in
```kconfig
config BR2_PACKAGE_NEUROS_AGENTD
	bool "neuros-agentd"
	select BR2_PACKAGE_TMUX
	help
	  NeurOS agent orchestrator. Runs the selected AI agent CLI inside a
	  tmux session, tees its output to the TTS filter, injects STT
	  transcripts, and drives the compositor's status panes via neuros-ctl.

	  Prototype: POSIX shell. Becomes Rust once the design settles.
```

## package/neuros-comp/Config.in
```kconfig
config BR2_PACKAGE_NEUROS_COMP
	bool "neuros-comp (NeurOS compositor)"
	depends on !BR2_STATIC_LIBS # wlroots
	depends on BR2_TOOLCHAIN_HAS_THREADS # wlroots
	depends on BR2_PACKAGE_HAS_LIBEGL # wlroots
	depends on BR2_PACKAGE_HAS_LIBGLES # wlroots
	depends on BR2_PACKAGE_HAS_LIBGBM # wlroots
	select BR2_PACKAGE_WLROOTS
	select BR2_PACKAGE_WAYLAND
	select BR2_PACKAGE_WAYLAND_PROTOCOLS
	select BR2_PACKAGE_LIBXKBCOMMON
	select BR2_PACKAGE_FCFT
	select BR2_PACKAGE_PIXMAN
	select BR2_PACKAGE_FONTCONFIG
	help
	  The NeurOS Wayland compositor: a fork of cage (the kiosk
	  compositor), base v0.2.1. Draws the 4-zone NeurOS shell -
	  agent/model bar, center pane, state bar - over a per-agent
	  GLES gradient, and runs one embedded terminal / client.

	  https://github.com/cage-kiosk/cage

comment "neuros-comp needs a glibc/musl toolchain w/ threads, dynamic library, EGL/GLES/GBM"
	depends on BR2_STATIC_LIBS || !BR2_TOOLCHAIN_HAS_THREADS || \
		!BR2_PACKAGE_HAS_LIBEGL || !BR2_PACKAGE_HAS_LIBGLES || \
		!BR2_PACKAGE_HAS_LIBGBM
```

## package/neuros-memory-mcp/Config.in
```kconfig
config BR2_PACKAGE_NEUROS_MEMORY_MCP
	bool "neuros-memory-mcp (shared agent memory cache)"
	depends on BR2_PACKAGE_HOST_GO_TARGET_ARCH_SUPPORTS
	depends on BR2_PACKAGE_HOST_GO_TARGET_CGO_LINKING_SUPPORTS
	help
	  On-device MCP server for the shared agent memory. Serves the
	  memory_list / memory_read / memory_search / memory_write /
	  memory_delete tools to Claude Code, backed by a local cache in
	  front of the canonical neuros-memory Cloudflare Worker
	  (MEMORY_MCP_URL in /etc/neuros/memory.conf) - reads pass through
	  and are mirrored, writes hit the cache and are pushed (queued
	  while offline). Claude on claude.ai talks to the Worker directly.

comment "neuros-memory-mcp needs a Go-capable toolchain"
	depends on !BR2_PACKAGE_HOST_GO_TARGET_ARCH_SUPPORTS || \
		!BR2_PACKAGE_HOST_GO_TARGET_CGO_LINKING_SUPPORTS
```

## package/piper-voices/Config.in
```kconfig
config BR2_PACKAGE_PIPER_VOICES
	bool "piper-voices (ryan + ruslan, medium)"
	depends on BR2_PACKAGE_PIPER
	help
	  Piper voice models: en_US-ryan-medium and ru_RU-ruslan-medium
	  (male, ~63 MB each). Installed to /usr/share/piper-voices/.
```

## package/piper/Config.in
```kconfig
config BR2_PACKAGE_PIPER
	bool "piper (TTS)"
	depends on BR2_x86_64 || BR2_aarch64
	depends on BR2_TOOLCHAIN_USES_GLIBC
	help
	  Piper - fast local neural text-to-speech. Prebuilt upstream release
	  (bundles onnxruntime + espeak-ng). Voice models (.onnx) are shipped
	  separately.

	  https://github.com/rhasspy/piper

comment "piper needs a glibc x86_64/aarch64 toolchain"
	depends on !((BR2_x86_64 || BR2_aarch64) && BR2_TOOLCHAIN_USES_GLIBC)
```

## package/whisper-cpp/Config.in
```kconfig
config BR2_PACKAGE_WHISPER_CPP
	bool "whisper-cpp (STT)"
	depends on BR2_INSTALL_LIBSTDCPP
	depends on BR2_TOOLCHAIN_HAS_THREADS
	help
	  whisper.cpp - OpenAI Whisper speech-to-text, built from source.
	  Installs whisper-cli. Models (ggml-*.bin) are shipped separately.

	  https://github.com/ggml-org/whisper.cpp

comment "whisper-cpp needs a toolchain w/ C++ and threads"
	depends on !BR2_INSTALL_LIBSTDCPP || !BR2_TOOLCHAIN_HAS_THREADS
```

## package/whisper-model/Config.in
```kconfig
config BR2_PACKAGE_WHISPER_MODEL
	bool "whisper-model (small, multilingual, f16)"
	depends on BR2_PACKAGE_WHISPER_CPP
	help
	  ggml-small.bin - Whisper small multilingual model, f16 (~466 MB).
	  Installed to /usr/share/whisper-models/. This is NeurOS's chosen
	  STT model (no quantization).
```
